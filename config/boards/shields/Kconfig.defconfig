## config/boards/shields/Kconfig.defconfig
```kconfig
if SHIELD_splitkeyboard_LEFT

config ZMK_KEYBOARD_NAME
    default "splitkeyboard"

config ZMK_SPLIT_ROLE_CENTRAL
    default y

endif

if SHIELD_splitkeyboard_LEFT || SHIELD_splitkeyboard_RIGHT

config ZMK_SPLIT
    default y

endif
```

## config/boards/shields/Kconfig.shield
```kconfig
config SHIELD_SPLITKEYBOARD_LEFT
    def_bool $(shields_list_contains,splitkeyboard_left)

config SHIELD_SPLITKEYBOARD_RIGHT
    def_bool $(shields_list_contains,splitkeyboard_right)
```

## config/boards/shields/splitkeyboard/Kconfig.defconfig
```kconfig
if SHIELD_SPLITKEYBOARD_LEFT

config ZMK_KEYBOARD_NAME
    default "Splitkeyboard"

config ZMK_SPLIT_ROLE_CENTRAL
    default y

endif

if SHIELD_SPLITKEYBOARD_LEFT || SHIELD_SPLITKEYBOARD_RIGHT

config ZMK_SPLIT
    default y

endif
```
